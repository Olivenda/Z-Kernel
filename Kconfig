## Kconfig
```kconfig
mainmenu "Linux Kernel Configuration"

menu "General System Configuration"

config LOCALVERSION
    string "Local version suffix"
    default ""
    help
      Optional local suffix appended to the kernel release string.

config DEFAULT_HOSTNAME
    string "Default hostname"
    default "zkernel"
    help
      Hostname used if none is supplied by userland.

config USE_GRUB
    bool "Build bootable GRUB-mkrescue ISO"
    default y
    help
      When enabled, a GRUB-mkrescue ISO image is generated.

config ENABLE_BIN
    bool "Generate raw kernel binary"
    default y
    help
      Produce a flat binary alongside the ELF kernel.

config GENERATE_MAP
    bool "Generate linker map file"
    default y
    help
      Emit a linker map for symbol inspection.

config BOOT_BANNER
    bool "Print boot banner"
    default y
    help
      Show a boot banner before other log messages.

config LOG_ROOTFS
    bool "Log root filesystem contents"
    default y
    help
      Initialize the bundled rootfs and print its entries.

config CUSTOM_CFLAGS
    string "Additional compiler flags"
    default ""
    help
      Extra flags appended to the default kernel CFLAGS.

config OPT_LEVEL
    string "Optimization level"
    default "O2"
    help
      GCC optimization level (e.g. O0, O1, O2, O3).

endmenu


menu "Module & Block Layer Options"

config MODULES
    bool "Loadable module support (stub)"
    default n
    help
      Stub option matching classic menuconfig layout.

config BLOCK
    bool "Block layer (stub)"
    default y
    help
      Placeholder representing block device support.

endmenu


menu "CPU & Architecture Options"

config HELLO
    bool "Enable Hello World message"
    default y
    help
      Print a hello message from the kernel entry point.

choice
    prompt "Hello language"
    default LANG_EN

config LANG_EN
    bool "English"

config LANG_DE
    bool "German"

endchoice

config ENABLE_PAGING
    bool "Enable paging"
    default n
    help
      Placeholder for future paging/MMU features.

endmenu


menu "Memory & RAM Options"

config LOG_MEMORY_MAP
    bool "Log usable memory map"
    default y
    help
      Log Stivale2 memory ranges detected at boot.

config HEAP_DEMO
    bool "Allocate demo heap page"
    default y
    help
      Allocate and report a demo page from the bump allocator.

config MEM_TEST_PATTERN
    bool "Emit memory test pattern"
    default n
    help
      Placeholder for simple memory diagnostic patterns.

endmenu


menu "Power Management & ACPI"

config PM_STUB
    bool "Power management stub"
    default n
    help
      Placeholder for ACPI/PM menu.

endmenu


menu "Bus Options (PCI etc.)"

config PCI_STUB
    bool "PCI support (stub)"
    default n
    help
      Placeholder for PCI menu layout.

endmenu


menu "Filesystem Support"

config FS_STUB
    bool "Generic filesystem support (stub)"
    default y

config RAMFS_SUPPORT
    bool "Built-in RAMFS-style root"
    default y

config EXT_STUB
    bool "EXT-style filesystem (stub)"
    default n

endmenu


menu "Networking Support"

config NET_STUB
    bool "Networking stack (stub)"
    default n

config NET_LOOPBACK
    bool "Loopback device"
    default y

config NET_IPV4_PLACEHOLDER
    bool "IPv4 core options (stub)"
    default n

endmenu


menu "Network Tools & Diagnostics"

config NET_PING_TRACE
    tristate "Ping/Traceroute utilities"
    default y

config NET_PACKET_ANALYZER
    tristate "Packet analyzer tool"
    default m

config NET_CONGESTION_SUITE
    tristate "TCP congestion test suite"
    default n

config NET_WOL_UTILS
    bool "Wake-on-LAN utilities"
    default n

config NET_ROUTING_HELPERS
    bool "Routing helper utilities"
    default n

config NET_SPEEDTEST_CLI
    tristate "Speedtest CLI module"
    default m

endmenu


menu "Security & Hardening Tools"

config SECURITY_STUB
    bool "Generic security options (stub)"
    default n

config SECURITY_FIREWALL_HELPERS
    bool "Firewall helper routines"
    default n

config SECURITY_IDS_COMPONENTS
    bool "Intrusion detection components"
    default n

config SECURITY_SANDBOX_HELPERS
    tristate "Sandboxing helpers"
    default m

config SECURITY_SECURE_RANDOM
    bool "Secure random generator tunables"
    default n

config SECURITY_PASSWORD_HASHING
    tristate "Password hashing utilities"
    default m

endmenu


menu "Cryptography & Key Management"

config ELF_STUB
    bool "ELF loader support (stub)"
    default y

endmenu


menu "Debugging, Profiling & Logging"

config ENABLE_DEBUG
    bool "Enable debug symbols (-g)"
    default n

config DEBUG_LOG_ROOTFS
    bool "Verbose rootfs logging"
    default n

config DEBUG_KERNEL_PANIC_TOOLS
    bool "Kernel panic simulation tools"
    default n

config DEBUG_PERF_ANALYSIS
    tristate "Perf event analysis"
    default m

config DEBUG_TRACING_SUBSYSTEM
    tristate "System tracing subsystem"
    default m

endmenu


menu "Virtualization & Containers"

config VIRT_STUB
    bool "Virtualization support (stub)"
    default n

config VIRT_CONTAINER_HELPERS
    tristate "Container helper utilities"
    default n

endmenu


menu "Hardware Utilities & Sensors"

config HW_CPU_SENSORS
    tristate "CPU sensors"
    default m

config HW_FAN_CONTROL
    tristate "Fan control"
    default m

config HW_THERMAL_CALIBRATION
    tristate "Thermal calibration tool"
    default n

config HW_BATTERY_DIAGNOSTICS
    bool "Battery diagnostics"
    default n

endmenu


menu "Bootloader & Firmware Options"

config ENABLE_SERIAL_DEBUG
    bool "Enable serial debug output"
    default n

config ENABLE_KEYBOARD_ECHO
    bool "Enable keyboard echo"
    default y

menu "Graphics Support"

config FRAMEBUFFER_ENABLE
    bool "Framebuffer console"
    default y

config FRAMEBUFFER_BG_COLOR
    string "Framebuffer background color (0xRRGGBB)"
    default "0x000000"

config FRAMEBUFFER_TEST_PATTERN
    bool "Framebuffer test pattern"
    default n

config VGA_COLOR
    string "VGA text attribute (0xF0B0)"
    default "0x0700"

endmenu
endmenu


menu "Userland Tools & Service Utilities"

config USERLAND_BASE_TOOLS
    bool "Base userland tools"
    default y

config USERLAND_SERVICE_WRAPPERS
    bool "Service manager wrappers"
    default n

config USERLAND_LOG_COLLECTOR
    tristate "Log collection utilities"
    default n

config USERLAND_RESCUE_SHELL
    bool "Rescue shell"
    default y

endmenu
```
